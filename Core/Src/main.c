/* USER CODE BEGIN Header */
/**
  ******************************************************************************
  * @file           : main.c
  * @brief          : Main program body
  ******************************************************************************
  * @attention
  *
  * Copyright (c) 2023 STMicroelectronics.
  * All rights reserved.
  *
  * This software is licensed under terms that can be found in the LICENSE file
  * in the root directory of this software component.
  * If no LICENSE file comes with this software, it is provided AS-IS.
  *
  ******************************************************************************
  */
/* USER CODE END Header */
/* Includes ------------------------------------------------------------------*/
#include "main.h"

/* Private includes ----------------------------------------------------------*/
/* USER CODE BEGIN Includes */
#include <stdio.h>

#include "ai_datatypes_defines.h"
#include "ai_platform.h"
#include "network_data.h"
#include "network.h"
/* USER CODE END Includes */

/* Private typedef -----------------------------------------------------------*/
/* USER CODE BEGIN PTD */

/* USER CODE END PTD */

/* Private define ------------------------------------------------------------*/
/* USER CODE BEGIN PD */
/* USER CODE END PD */

/* Private macro -------------------------------------------------------------*/
/* USER CODE BEGIN PM */

/* USER CODE END PM */

/* Private variables ---------------------------------------------------------*/

CRC_HandleTypeDef hcrc;

TIM_HandleTypeDef htim16;

UART_HandleTypeDef huart1;

/* USER CODE BEGIN PV */

/* 模型句柄 */
static ai_handle network = AI_HANDLE_NULL;

/* 神经网络中间�?? ( �??活缓冲区 ) */
AI_ALIGNED(32)
static ai_u8 activations[AI_NETWORK_DATA_ACTIVATIONS_SIZE];

/* 输入张量的缓冲区 */
AI_ALIGNED(32)
static ai_float in_data[AI_NETWORK_IN_1_SIZE];
// static ai_u8 in_data[AI_NETWORK_IN_1_SIZE_BYTES];

/* 输出张量的缓冲区 */
AI_ALIGNED(32)
static ai_float out_data[AI_NETWORK_OUT_1_SIZE];
// static ai_u8 out_data[AI_NETWORK_OUT_1_SIZE_BYTES];

/* 模型输入输出张量指针 */
static ai_buffer *ai_input;
static ai_buffer *ai_output;

//uint8_t data[AI_NETWORK_IN_1_SIZE] = {
//		255,255,255, 255,255,255, 255,255,255, 255,255,255, 255,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255,
//		255,255,255, 255,255,255, 255,255,255, 255,255,255, 255,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255,
//		255,255,255, 255,255,255, 255,255,255, 255,255,255, 255,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255,
//		255,255,255, 255,255,255, 255,255,255, 255,255,255, 255,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255,
//		255,255,255, 255,255,255, 255,255,255, 255,255,255, 255,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255,
//		255,255,255, 255,255,255, 255,255,255, 255,255,255, 255,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255,
//		255,255,255, 255,255,255, 255,255,255, 255,255,255, 255,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255,
//		255,255,255, 255,255,255, 255,255,255, 255,255,255, 255,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255,
//		255,255,255, 255,255,255, 255,255,255, 255,255,255, 255,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255,
//		255,255,255, 255,255,255, 255,255,255, 255,255,255, 255,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255,
//		255,255,255, 255,255,255, 255,255,255, 255,255,255, 255,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255,
//		255,255,255, 255,255,255, 255,255,255, 255,255,255, 255,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255,
//		255,255,255, 255,255,255, 255,255,255, 255,255,255, 255,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255,
//		255,255,255, 255,255,255, 255,255,255, 255,255,255, 255,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255,
//		255,255,255, 255,255,255, 255,255,255, 255,255,255, 255,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255,
//		255,255,255, 255,255,255, 255,255,255, 255,255,255, 255,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255,
//		255,255,255, 255,255,255, 255,255,255, 255,255,255, 255,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255,
//		255,255,255, 255,255,255, 255,255,255, 255,255,255, 255,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255,
//		255,255,255, 255,255,255, 255,255,255, 255,255,255, 255,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255,
//		255,255,255, 255,255,255, 255,255,255, 255,255,255, 255,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255,
//		255,255,255, 255,255,255, 255,255,255, 255,255,255, 255,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255,
//		255,255,255, 255,255,255, 255,255,255, 255,255,255, 255,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255,
//		255,255,255, 255,255,255, 255,255,255, 255,255,255, 255,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255,
//		255,255,255, 255,255,255, 255,255,255, 255,255,255, 255,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255,
//		255,255,255, 255,255,255, 255,255,255, 255,255,255, 255,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255,
//		255,255,255, 255,255,255, 255,255,255, 255,255,255, 255,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255,
//		255,255,255, 255,255,255, 255,255,255, 255,255,255, 255,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255,
//		255,255,255, 255,255,255, 255,255,255, 255,255,255, 255,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255,
//		255,255,255, 255,255,255, 255,255,255, 255,255,255, 255,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255,
//		255,255,255, 255,255,255, 255,255,255, 255,255,255, 255,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255,
//		255,255,255, 255,255,255, 255,255,255, 255,255,255, 255,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255,
//		255,255,255, 255,255,255, 255,255,255, 255,255,255, 255,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255,
//		};


//uint8_t data[AI_NETWORK_IN_1_SIZE] = {
//		40, 48, 48,  40, 52, 48,  48, 52, 48,  40, 48, 48,  40,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 24,
//		40, 52, 48,  40, 52, 48,  40, 40, 48,  24, 32, 40,  24,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 32,
//		40, 44, 40,  40, 36, 40,  24, 28, 32,  24, 20, 32,  24,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 24,
//		32, 32, 40,  32, 28, 40,  24, 24, 40,  32, 40, 40,  56,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 24,
//		24, 24, 32,  32, 28, 40,  32, 44, 40,  72, 76, 72,  88,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 24,
//		24, 20, 32,  32, 32, 40,  48, 52, 56,  88, 84, 96, 104,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 24,
//		24, 28, 32,  32, 28, 40,  72, 72, 80,  96,112,112,  96,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 32,
//		32, 28, 32,  40, 48, 56,  88,104, 96, 104, 96,104,  72,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 32,
//		24, 32, 32,  48, 56, 56,  96,112,104,  96, 96,104,  48,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 32,
//		32, 28, 40,  56, 72, 72, 112,136,128,  88,100,104,  48,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 32,
//		40, 40, 48,  64, 92, 80,  96,104,112,  88, 84, 96,  48,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 32,
//		32, 20, 40,  64, 80, 72, 104,124,120,  80, 80, 96,  40,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 32,
//		32, 40, 40,  64, 72, 64, 104,128,120,  80, 84, 96,  48,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 32,
//		40, 28, 40,  56, 56, 64,  96,108,112,  88, 84, 96,  48,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 32,
//		40, 36, 40,  48, 44, 56,  88, 96,104,  96, 96,104,  48,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 32,
//		32, 32, 32,  32, 40, 40,  88,112,104,  96,108,104,  64,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 32,
//		32, 28, 32,  24, 24, 40,  72, 84, 80,  96,112,104,  80,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 32,
//		32, 32, 40,  32, 36, 40,  56, 68, 64,  96,108,120,  88,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 32,
//		32, 36, 40,  40, 32, 40,  40, 48, 40,  88,100, 96, 112,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 40,
//		32, 32, 32,  32, 28, 32,  40, 36, 48,  56, 76, 64,  96,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 40,
//		32, 32, 32,  32, 28, 32,  32, 36, 40,  32, 36, 40,  72,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 40,
//		24, 36, 32,  32, 32, 32,  32, 36, 40,  32, 40, 40,  32,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 40,
//		32, 36, 40,  40, 32, 40,  32, 32, 40,  32, 36, 40,  40,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 40,
//		32, 36, 32,  32, 36, 40,  32, 36, 40,  32, 36, 40,  40,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 40,
//		32, 36, 40,  32, 36, 40,  40, 36, 40,  40, 40, 40,  48,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 40,
//		40, 44, 40,  40, 44, 40,  48, 44, 48,  48, 44, 48,  48,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 40,
//		56, 52, 40,  56, 52, 40,  56, 56, 48,  64, 60, 64,  72,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104,
//		144,128,128, 144,140,136, 144,148,128, 144,144,136, 144,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152,
//		144,144,144, 144,152,144, 136,148,136, 136,144,144, 144,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152,
//		144,148,152, 144,148,144, 152,148,152, 144,148,152, 144,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152,
//		144,148,152, 144,152,152, 152,148,152, 152,152,152, 152,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152,
//		144,148,144, 144,148,144, 152,152,152, 152,152,152, 152,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152,
//		};


uint8_t data[AI_NETWORK_IN_1_SIZE] = {
		 96, 96, 88,  96,108, 96, 104,112, 96,  96, 96, 96,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 56,
		 24, 12,  8,  24, 24, 16,  24, 28, 16,  48, 32, 32,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 24,
		 32, 32, 24,  32, 28, 24,  32, 28, 24,  40, 28, 32,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 24,
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		152,156,144, 152,160,144, 152,160,144, 152,160,144,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152,
		};

/* USER CODE END PV */

/* Private function prototypes -----------------------------------------------*/
void SystemClock_Config(void);
static void SystemPower_Config(void);
static void MX_GPIO_Init(void);
static void MX_USART1_UART_Init(void);
static void MX_ICACHE_Init(void);
static void MX_CRC_Init(void);
static void MX_TIM16_Init(void);
/* USER CODE BEGIN PFP */

static int aiInit(void);
static int aiRun(const void *in_data, void *out_data);


/* USER CODE END PFP */

/* Private user code ---------------------------------------------------------*/
/* USER CODE BEGIN 0 */

/* USER CODE END 0 */

/**
  * @brief  The application entry point.
  * @retval int
  */
int main(void)
{
  /* USER CODE BEGIN 1 */
	char buf[100];
	int buf_len = 0;
	uint32_t timestamp;
	uint32_t timestamp1;
	float y_val[10];
	float y_vall[10];
	int	y_valll[10];
	float min, max, Radius;

  /* USER CODE END 1 */

  /* MCU Configuration--------------------------------------------------------*/

  /* Reset of all peripherals, Initializes the Flash interface and the Systick. */
  HAL_Init();

  /* USER CODE BEGIN Init */

  /* USER CODE END Init */

  /* Configure the system clock */
  SystemClock_Config();

  /* Configure the System Power */
  SystemPower_Config();

  /* USER CODE BEGIN SysInit */

  /* USER CODE END SysInit */

  /* Initialize all configured peripherals */
  MX_GPIO_Init();
  MX_USART1_UART_Init();
  MX_ICACHE_Init();
  MX_CRC_Init();
  MX_TIM16_Init();
  /* USER CODE BEGIN 2 */

  __HAL_RCC_CRC_CLK_ENABLE();	/* 启用CRC IP时钟以使用神经网络运行时�?? */

  HAL_TIM_Base_Start(&htim16);	/* 打开计时�?? */

  HAL_GPIO_WritePin(LED_RED_GPIO_Port, LED_RED_Pin, GPIO_PIN_SET);
  HAL_GPIO_WritePin(LED_GREEN_GPIO_Port, LED_GREEN_Pin, GPIO_PIN_SET);
  HAL_GPIO_WritePin(LED_BLUE_GPIO_Port, LED_BLUE_Pin, GPIO_PIN_SET);
//  HAL_GPIO_WritePin(LED_RED_GPIO_Port, LED_RED_Pin, GPIO_PIN_RESET);
//  HAL_GPIO_WritePin(LED_GREEN_GPIO_Port, LED_GREEN_Pin, GPIO_PIN_RESET);
//  HAL_GPIO_WritePin(LED_BLUE_GPIO_Port, LED_BLUE_Pin, GPIO_PIN_RESET);

  /* 初始化推�?? */
  aiInit();

  /* USER CODE END 2 */

  /* Infinite loop */
  /* USER CODE BEGIN WHILE */
  while (1)
  {

	// 填充输入缓冲�?? */
	for (uint32_t i = 0; i < AI_NETWORK_IN_1_SIZE; i++)
	{
	  ((ai_float *)in_data)[i] = data[i];
	}

	/* 获取当前时间�?? */
	timestamp = htim16.Instance->CNT;

	/* 运行推理 */
	aiRun(in_data, out_data);

	/* 获取当前时间�? */
	timestamp1 = htim16.Instance->CNT;

	if(timestamp > timestamp1)
		timestamp1 = timestamp1 + 65535 - timestamp;
	else
		timestamp1 = timestamp1 - timestamp;

	/* 输出推理时间 (微秒) */
	buf_len = sprintf(buf,
							"duration: %lu us\r\n",
							timestamp1);
	HAL_UART_Transmit(&huart1, (uint8_t *)buf, buf_len, 100);


	/* 读取神经网络的输�?? */
	for(int i = 0; i < AI_NETWORK_OUT_1_SIZE; i++)
		y_val[i] = ((float *)out_data)[i];

	min = y_val[0];
	max = y_val[0];
	for (int i = 0; i < AI_NETWORK_OUT_1_SIZE; i++)
	{
		if (y_val[i] < min)
			min = y_val[i];
		if (y_val[i] > max)
			max = y_val[i];
	}

	Radius = max - min;

	for (int i = 0; i < AI_NETWORK_OUT_1_SIZE; i ++)
	{
		y_vall[i] = (y_val[i] - min) / Radius;

		y_valll[i] = (int)(y_vall[i]*1000*100);

		buf_len = sprintf(buf,
								"number: %d  output: %6d\r\n",
								i,
								y_valll[i]);
		HAL_UART_Transmit(&huart1, (uint8_t *)buf, buf_len, 100);
	}


    /* USER CODE END WHILE */

    /* USER CODE BEGIN 3 */
  }
  /* USER CODE END 3 */
}

/**
  * @brief System Clock Configuration
  * @retval None
  */
void SystemClock_Config(void)
{
  RCC_OscInitTypeDef RCC_OscInitStruct = {0};
  RCC_ClkInitTypeDef RCC_ClkInitStruct = {0};

  /** Configure the main internal regulator output voltage
  */
  if (HAL_PWREx_ControlVoltageScaling(PWR_REGULATOR_VOLTAGE_SCALE1) != HAL_OK)
  {
    Error_Handler();
  }

  /** Initializes the CPU, AHB and APB buses clocks
  */
  RCC_OscInitStruct.OscillatorType = RCC_OSCILLATORTYPE_MSI;
  RCC_OscInitStruct.MSIState = RCC_MSI_ON;
  RCC_OscInitStruct.MSICalibrationValue = RCC_MSICALIBRATION_DEFAULT;
  RCC_OscInitStruct.MSIClockRange = RCC_MSIRANGE_4;
  RCC_OscInitStruct.PLL.PLLState = RCC_PLL_ON;
  RCC_OscInitStruct.PLL.PLLSource = RCC_PLLSOURCE_MSI;
  RCC_OscInitStruct.PLL.PLLMBOOST = RCC_PLLMBOOST_DIV1;
  RCC_OscInitStruct.PLL.PLLM = 1;
  RCC_OscInitStruct.PLL.PLLN = 80;
  RCC_OscInitStruct.PLL.PLLP = 2;
  RCC_OscInitStruct.PLL.PLLQ = 2;
  RCC_OscInitStruct.PLL.PLLR = 2;
  RCC_OscInitStruct.PLL.PLLRGE = RCC_PLLVCIRANGE_0;
  RCC_OscInitStruct.PLL.PLLFRACN = 0;
  if (HAL_RCC_OscConfig(&RCC_OscInitStruct) != HAL_OK)
  {
    Error_Handler();
  }

  /** Initializes the CPU, AHB and APB buses clocks
  */
  RCC_ClkInitStruct.ClockType = RCC_CLOCKTYPE_HCLK|RCC_CLOCKTYPE_SYSCLK
                              |RCC_CLOCKTYPE_PCLK1|RCC_CLOCKTYPE_PCLK2
                              |RCC_CLOCKTYPE_PCLK3;
  RCC_ClkInitStruct.SYSCLKSource = RCC_SYSCLKSOURCE_PLLCLK;
  RCC_ClkInitStruct.AHBCLKDivider = RCC_SYSCLK_DIV1;
  RCC_ClkInitStruct.APB1CLKDivider = RCC_HCLK_DIV1;
  RCC_ClkInitStruct.APB2CLKDivider = RCC_HCLK_DIV1;
  RCC_ClkInitStruct.APB3CLKDivider = RCC_HCLK_DIV1;

  if (HAL_RCC_ClockConfig(&RCC_ClkInitStruct, FLASH_LATENCY_4) != HAL_OK)
  {
    Error_Handler();
  }
}

/**
  * @brief Power Configuration
  * @retval None
  */
static void SystemPower_Config(void)
{
  HAL_PWREx_EnableVddIO2();

  /*
   * Disable the internal Pull-Up in Dead Battery pins of UCPD peripheral
   */
  HAL_PWREx_DisableUCPDDeadBattery();

  /*
   * Switch to SMPS regulator instead of LDO
   */
  if (HAL_PWREx_ConfigSupply(PWR_SMPS_SUPPLY) != HAL_OK)
  {
    Error_Handler();
  }
}

/**
  * @brief CRC Initialization Function
  * @param None
  * @retval None
  */
static void MX_CRC_Init(void)
{

  /* USER CODE BEGIN CRC_Init 0 */

  /* USER CODE END CRC_Init 0 */

  /* USER CODE BEGIN CRC_Init 1 */

  /* USER CODE END CRC_Init 1 */
  hcrc.Instance = CRC;
  hcrc.Init.DefaultPolynomialUse = DEFAULT_POLYNOMIAL_ENABLE;
  hcrc.Init.DefaultInitValueUse = DEFAULT_INIT_VALUE_ENABLE;
  hcrc.Init.InputDataInversionMode = CRC_INPUTDATA_INVERSION_NONE;
  hcrc.Init.OutputDataInversionMode = CRC_OUTPUTDATA_INVERSION_DISABLE;
  hcrc.InputDataFormat = CRC_INPUTDATA_FORMAT_BYTES;
  if (HAL_CRC_Init(&hcrc) != HAL_OK)
  {
    Error_Handler();
  }
  /* USER CODE BEGIN CRC_Init 2 */

  /* USER CODE END CRC_Init 2 */

}

/**
  * @brief ICACHE Initialization Function
  * @param None
  * @retval None
  */
static void MX_ICACHE_Init(void)
{

  /* USER CODE BEGIN ICACHE_Init 0 */

  /* USER CODE END ICACHE_Init 0 */

  /* USER CODE BEGIN ICACHE_Init 1 */

  /* USER CODE END ICACHE_Init 1 */

  /** Enable instruction cache in 1-way (direct mapped cache)
  */
  if (HAL_ICACHE_ConfigAssociativityMode(ICACHE_1WAY) != HAL_OK)
  {
    Error_Handler();
  }
  if (HAL_ICACHE_Enable() != HAL_OK)
  {
    Error_Handler();
  }
  /* USER CODE BEGIN ICACHE_Init 2 */

  /* USER CODE END ICACHE_Init 2 */

}

/**
  * @brief TIM16 Initialization Function
  * @param None
  * @retval None
  */
static void MX_TIM16_Init(void)
{

  /* USER CODE BEGIN TIM16_Init 0 */

  /* USER CODE END TIM16_Init 0 */

  /* USER CODE BEGIN TIM16_Init 1 */

  /* USER CODE END TIM16_Init 1 */
  htim16.Instance = TIM16;
  htim16.Init.Prescaler = 159;
  htim16.Init.CounterMode = TIM_COUNTERMODE_UP;
  htim16.Init.Period = 65535;
  htim16.Init.ClockDivision = TIM_CLOCKDIVISION_DIV1;
  htim16.Init.RepetitionCounter = 0;
  htim16.Init.AutoReloadPreload = TIM_AUTORELOAD_PRELOAD_ENABLE;
  if (HAL_TIM_Base_Init(&htim16) != HAL_OK)
  {
    Error_Handler();
  }
  /* USER CODE BEGIN TIM16_Init 2 */

  /* USER CODE END TIM16_Init 2 */

}

/**
  * @brief USART1 Initialization Function
  * @param None
  * @retval None
  */
static void MX_USART1_UART_Init(void)
{

  /* USER CODE BEGIN USART1_Init 0 */

  /* USER CODE END USART1_Init 0 */

  /* USER CODE BEGIN USART1_Init 1 */

  /* USER CODE END USART1_Init 1 */
  huart1.Instance = USART1;
  huart1.Init.BaudRate = 115200;
  huart1.Init.WordLength = UART_WORDLENGTH_8B;
  huart1.Init.StopBits = UART_STOPBITS_1;
  huart1.Init.Parity = UART_PARITY_NONE;
  huart1.Init.Mode = UART_MODE_TX_RX;
  huart1.Init.HwFlowCtl = UART_HWCONTROL_NONE;
  huart1.Init.OverSampling = UART_OVERSAMPLING_16;
  huart1.Init.OneBitSampling = UART_ONE_BIT_SAMPLE_DISABLE;
  huart1.Init.ClockPrescaler = UART_PRESCALER_DIV1;
  huart1.AdvancedInit.AdvFeatureInit = UART_ADVFEATURE_NO_INIT;
  if (HAL_UART_Init(&huart1) != HAL_OK)
  {
    Error_Handler();
  }
  if (HAL_UARTEx_SetTxFifoThreshold(&huart1, UART_TXFIFO_THRESHOLD_1_8) != HAL_OK)
  {
    Error_Handler();
  }
  if (HAL_UARTEx_SetRxFifoThreshold(&huart1, UART_RXFIFO_THRESHOLD_1_8) != HAL_OK)
  {
    Error_Handler();
  }
  if (HAL_UARTEx_DisableFifoMode(&huart1) != HAL_OK)
  {
    Error_Handler();
  }
  /* USER CODE BEGIN USART1_Init 2 */

  /* USER CODE END USART1_Init 2 */

}

/**
  * @brief GPIO Initialization Function
  * @param None
  * @retval None
  */
static void MX_GPIO_Init(void)
{
  GPIO_InitTypeDef GPIO_InitStruct = {0};

  /* GPIO Ports Clock Enable */
  __HAL_RCC_GPIOC_CLK_ENABLE();
  __HAL_RCC_GPIOB_CLK_ENABLE();
  __HAL_RCC_GPIOG_CLK_ENABLE();
  __HAL_RCC_GPIOA_CLK_ENABLE();

  /*Configure GPIO pin Output Level */
  HAL_GPIO_WritePin(LED_RED_GPIO_Port, LED_RED_Pin, GPIO_PIN_RESET);

  /*Configure GPIO pin Output Level */
  HAL_GPIO_WritePin(LED_GREEN_GPIO_Port, LED_GREEN_Pin, GPIO_PIN_RESET);

  /*Configure GPIO pin Output Level */
  HAL_GPIO_WritePin(GPIOB, UCPD_DBn_Pin|LED_BLUE_Pin, GPIO_PIN_RESET);

  /*Configure GPIO pin : USER_BUTTON_Pin */
  GPIO_InitStruct.Pin = USER_BUTTON_Pin;
  GPIO_InitStruct.Mode = GPIO_MODE_IT_FALLING;
  GPIO_InitStruct.Pull = GPIO_NOPULL;
  HAL_GPIO_Init(USER_BUTTON_GPIO_Port, &GPIO_InitStruct);

  /*Configure GPIO pin : UCPD_FLT_Pin */
  GPIO_InitStruct.Pin = UCPD_FLT_Pin;
  GPIO_InitStruct.Mode = GPIO_MODE_INPUT;
  GPIO_InitStruct.Pull = GPIO_NOPULL;
  HAL_GPIO_Init(UCPD_FLT_GPIO_Port, &GPIO_InitStruct);

  /*Configure GPIO pin : LED_RED_Pin */
  GPIO_InitStruct.Pin = LED_RED_Pin;
  GPIO_InitStruct.Mode = GPIO_MODE_OUTPUT_PP;
  GPIO_InitStruct.Pull = GPIO_PULLUP;
  GPIO_InitStruct.Speed = GPIO_SPEED_FREQ_HIGH;
  HAL_GPIO_Init(LED_RED_GPIO_Port, &GPIO_InitStruct);

  /*Configure GPIO pin : LED_GREEN_Pin */
  GPIO_InitStruct.Pin = LED_GREEN_Pin;
  GPIO_InitStruct.Mode = GPIO_MODE_OUTPUT_PP;
  GPIO_InitStruct.Pull = GPIO_PULLUP;
  GPIO_InitStruct.Speed = GPIO_SPEED_FREQ_HIGH;
  HAL_GPIO_Init(LED_GREEN_GPIO_Port, &GPIO_InitStruct);

  /*Configure GPIO pin : UCPD_DBn_Pin */
  GPIO_InitStruct.Pin = UCPD_DBn_Pin;
  GPIO_InitStruct.Mode = GPIO_MODE_OUTPUT_PP;
  GPIO_InitStruct.Pull = GPIO_NOPULL;
  GPIO_InitStruct.Speed = GPIO_SPEED_FREQ_LOW;
  HAL_GPIO_Init(UCPD_DBn_GPIO_Port, &GPIO_InitStruct);

  /*Configure GPIO pin : LED_BLUE_Pin */
  GPIO_InitStruct.Pin = LED_BLUE_Pin;
  GPIO_InitStruct.Mode = GPIO_MODE_OUTPUT_PP;
  GPIO_InitStruct.Pull = GPIO_PULLUP;
  GPIO_InitStruct.Speed = GPIO_SPEED_FREQ_HIGH;
  HAL_GPIO_Init(LED_BLUE_GPIO_Port, &GPIO_InitStruct);

}

/* USER CODE BEGIN 4 */

/*
 * 初始化推�???
 */
int aiInit(void) {

  ai_error err;
  int buff_len = 0;
  char buff[100];

  /* 创建和初始化模型 */
  const ai_handle acts[] = { activations };
  err = ai_network_create_and_init(&network, acts, NULL);

  if (err.type != AI_ERROR_NONE) {

	    buff_len = sprintf(buff,
	    						"Error: could not create NN instance or initialize\r\n");
	    HAL_UART_Transmit(&huart1, (uint8_t *)buff, buff_len, 100);
	    while(1);
  };

  /* 获取指向模型的输�???/输出张量的指�??? */
  ai_input = ai_network_inputs_get(network, NULL);
  ai_output = ai_network_outputs_get(network, NULL);

  return 0;
}

/*
 * 运行推理
 */
int aiRun(const void *in_data, void *out_data) {

  ai_i32 n_batch;
  ai_error err;
  int buff_len = 0;
  char buff[100];

  /* 1 - 更新输入和输出缓冲区的数据指�??? */
  ai_input[0].data = AI_HANDLE_PTR(in_data);
  ai_output[0].data = AI_HANDLE_PTR(out_data);

  /* 2 - 使用神经网络进行推理 */
  n_batch = ai_network_run(network, &ai_input[0], &ai_output[0]);

  if (n_batch != 1) {

      err = ai_network_get_error(network);

      buff_len = sprintf(buff,
    		  	  	  	  	  "Error: could not run inference because of %d\r\n",
							  err.type);
      HAL_UART_Transmit(&huart1, (uint8_t *)buff, buff_len, 100);
  };

  return 0;
}


/* USER CODE END 4 */

/**
  * @brief  This function is executed in case of error occurrence.
  * @retval None
  */
void Error_Handler(void)
{
  /* USER CODE BEGIN Error_Handler_Debug */
  /* User can add his own implementation to report the HAL error return state */
  __disable_irq();
  while (1)
  {
  }
  /* USER CODE END Error_Handler_Debug */
}

#ifdef  USE_FULL_ASSERT
/**
  * @brief  Reports the name of the source file and the source line number
  *         where the assert_param error has occurred.
  * @param  file: pointer to the source file name
  * @param  line: assert_param error line source number
  * @retval None
  */
void assert_failed(uint8_t *file, uint32_t line)
{
  /* USER CODE BEGIN 6 */
  /* User can add his own implementation to report the file name and line number,
     ex: printf("Wrong parameters value: file %s on line %d\r\n", file, line) */
  /* USER CODE END 6 */
}
#endif /* USE_FULL_ASSERT */
